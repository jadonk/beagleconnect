## sw/buildroot/Config.in
```kconfig
source "$BR2_EXTERNAL_beagleconnect_gateway_PATH/package/greybus-netlink-modules/Config.in"
source "$BR2_EXTERNAL_beagleconnect_gateway_PATH/package/gbridge/Config.in"
source "$BR2_EXTERNAL_beagleconnect_gateway_PATH/package/hm3301-module/Config.in"
source "$BR2_EXTERNAL_beagleconnect_gateway_PATH/package/wpanusb-module/Config.in"
```

## sw/buildroot/configs/beagleconnect_gateway_pocketbeagle_defconfig
```kconfig
BR2_arm=y
BR2_cortex_a8=y
BR2_DL_DIR="$(BR2_EXTERNAL)/dl"
BR2_CCACHE=y
BR2_TOOLCHAIN_BUILDROOT_GLIBC=y
BR2_TOOLCHAIN_BUILDROOT_CXX=y
BR2_TARGET_GENERIC_HOSTNAME="bcf-gateway"
BR2_INIT_SYSTEMD=y
BR2_TARGET_GENERIC_ROOT_PASSWD="temppwd"
BR2_TARGET_GENERIC_GETTY_PORT="ttyS0"
BR2_SYSTEM_DEFAULT_PATH="/bin:/sbin:/usr/bin:/usr/sbin"
BR2_ROOTFS_OVERLAY="$(BR2_EXTERNAL)/board/beagleboard/beagleconnect_gateway_pocketbeagle/rootfs_overlay"
BR2_ROOTFS_POST_IMAGE_SCRIPT="$(BR2_EXTERNAL)/board/beagleboard/beagleconnect_gateway_pocketbeagle/post-image.sh"
BR2_ROOTFS_POST_SCRIPT_ARGS="$(BR2_DEFCONFIG)"
BR2_LINUX_KERNEL=y
BR2_LINUX_KERNEL_CUSTOM_GIT=y
BR2_LINUX_KERNEL_CUSTOM_REPO_URL="https://github.com/beagleboard/linux"
BR2_LINUX_KERNEL_CUSTOM_REPO_VERSION="83153426ab2cb8fd4f375555604508875c1d29f2"
BR2_LINUX_KERNEL_PATCH="$(BR2_EXTERNAL)/patches/linux"
BR2_LINUX_KERNEL_DEFCONFIG="bb.org"
BR2_LINUX_KERNEL_CONFIG_FRAGMENT_FILES="$(BR2_EXTERNAL)/../linux/mikrobus.config"
BR2_LINUX_KERNEL_XZ=y
BR2_LINUX_KERNEL_DTS_SUPPORT=y
BR2_LINUX_KERNEL_INTREE_DTS_NAME="am335x-pocketbeagle am335x-boneblack am335x-bonegreen"
BR2_PACKAGE_TIO=y
BR2_PACKAGE_LIBGPIOD=y
BR2_PACKAGE_LIBGPIOD_TOOLS=y
BR2_PACKAGE_LIBIIO=y
BR2_PACKAGE_LIBIIO_IIOD_USBD=y
BR2_PACKAGE_LIBIIO_TESTS=y
BR2_PACKAGE_LIBUSB_EXAMPLES=y
BR2_PACKAGE_AVAHI_DAEMON=y
BR2_PACKAGE_DROPBEAR=y
BR2_PACKAGE_IPROUTE2=y
BR2_PACKAGE_IPUTILS=y
BR2_PACKAGE_MODEM_MANAGER=y
BR2_PACKAGE_MODEM_MANAGER_LIBMBIM=y
BR2_PACKAGE_MODEM_MANAGER_LIBQMI=y
BR2_PACKAGE_WPAN_TOOLS=y
BR2_PACKAGE_SCREEN=y
BR2_TARGET_ROOTFS_EXT2=y
BR2_TARGET_ROOTFS_EXT2_4=y
BR2_TARGET_ROOTFS_EXT2_SIZE="1G"
BR2_TARGET_UBOOT=y
BR2_TARGET_UBOOT_BUILD_SYSTEM_KCONFIG=y
BR2_TARGET_UBOOT_CUSTOM_VERSION=y
BR2_TARGET_UBOOT_CUSTOM_VERSION_VALUE="2020.04"
BR2_TARGET_UBOOT_BOARD_DEFCONFIG="am335x_evm"
BR2_TARGET_UBOOT_NEEDS_DTC=y
# BR2_TARGET_UBOOT_FORMAT_BIN is not set
BR2_TARGET_UBOOT_FORMAT_IMG=y
BR2_TARGET_UBOOT_SPL=y
BR2_TARGET_UBOOT_SPL_NAME="MLO"
BR2_PACKAGE_HOST_DOSFSTOOLS=y
BR2_PACKAGE_HOST_GENIMAGE=y
BR2_PACKAGE_HOST_MTOOLS=y
BR2_PACKAGE_GREYBUS_NETLINK_MODULES=y
BR2_PACKAGE_GBRIDGE=y
BR2_PACKAGE_HM3301_MODULE=y
BR2_PACKAGE_WPANUSB_MODULE=y
```

## sw/buildroot/configs/beagleconnect_gateway_qemu_x86_64_defconfig
```kconfig
BR2_x86_64=y
BR2_CCACHE=y
BR2_PACKAGE_HOST_LINUX_HEADERS_CUSTOM_5_10=y
BR2_TOOLCHAIN_BUILDROOT_WCHAR=y
BR2_TOOLCHAIN_BUILDROOT_CXX=y
BR2_TARGET_GENERIC_ROOT_PASSWD="temppwd"
BR2_SYSTEM_DHCP="eth0"
BR2_ROOTFS_OVERLAY="$(BR2_EXTERNAL)/board/beagleboard/beagleconnect_gateway_qemu_x86_64/rootfs_overlay"
BR2_ROOTFS_POST_BUILD_SCRIPT="board/qemu/x86_64/post-build.sh"
BR2_ROOTFS_POST_IMAGE_SCRIPT="board/qemu/post-image.sh"
BR2_ROOTFS_POST_SCRIPT_ARGS="$(BR2_DEFCONFIG)"
BR2_LINUX_KERNEL=y
BR2_LINUX_KERNEL_CUSTOM_VERSION=y
BR2_LINUX_KERNEL_CUSTOM_VERSION_VALUE="5.10.59"
BR2_LINUX_KERNEL_PATCH="$(BR2_EXTERNAL)/patches/linux"
BR2_LINUX_KERNEL_USE_CUSTOM_CONFIG=y
BR2_LINUX_KERNEL_CUSTOM_CONFIG_FILE="$(BR2_EXTERNAL)/board/beagleboard/beagleconnect_gateway_qemu_x86_64/linux.config"
BR2_LINUX_KERNEL_CONFIG_FRAGMENT_FILES="$(BR2_EXTERNAL)/../linux/mikrobus.config"
BR2_PACKAGE_LIBGPIOD=y
BR2_PACKAGE_LIBGPIOD_TOOLS=y
BR2_PACKAGE_LIBIIO=y
BR2_PACKAGE_LIBIIO_IIOD_USBD=y
BR2_PACKAGE_LIBIIO_TESTS=y
BR2_PACKAGE_LIBUSB_EXAMPLES=y
BR2_PACKAGE_AVAHI_DAEMON=y
BR2_PACKAGE_DROPBEAR=y
BR2_PACKAGE_IPROUTE2=y
BR2_PACKAGE_IPUTILS=y
BR2_PACKAGE_WPAN_TOOLS=y
BR2_PACKAGE_SCREEN=y
BR2_TARGET_ROOTFS_EXT2=y
# BR2_TARGET_ROOTFS_TAR is not set
BR2_PACKAGE_HOST_QEMU=y
BR2_PACKAGE_HOST_QEMU_SYSTEM_MODE=y
BR2_PACKAGE_HOST_QEMU_VDE2=y
BR2_PACKAGE_HOST_QEMU_USB=y
BR2_PACKAGE_GREYBUS_NETLINK_MODULES=y
BR2_PACKAGE_GBRIDGE=y
BR2_PACKAGE_HM3301_MODULE=y
BR2_PACKAGE_WPANUSB_MODULE=y
```

## sw/buildroot/package/gbridge/Config.in
```kconfig
config BR2_PACKAGE_GBRIDGE
	bool "gbridge"
	select BR2_PACKAGE_BLUEZ5_UTILS
	select BR2_PACKAGE_LIBNL
	select BR2_PACKAGE_AVAHI
	help
		Bridge network devices to Linux Greybus netlink interface.
```

## sw/buildroot/package/greybus-netlink-modules/Config.in
```kconfig
config BR2_PACKAGE_GREYBUS_NETLINK_MODULES
	bool "greybus-netlink-modules"
	depends on BR2_LINUX_KERNEL
	help
		Linux kernel modules for adding netlink support to greybus.
```

## sw/buildroot/package/hm3301-module/Config.in
```kconfig
config BR2_PACKAGE_HM3301_MODULE
	bool "hm3301-module"
	depends on BR2_LINUX_KERNEL
	help
		Linux kernel module for HM3301 particulate matter laser scaner.
```

## sw/buildroot/package/wpanusb-module/Config.in
```kconfig
config BR2_PACKAGE_WPANUSB_MODULE
	bool "wpanusb-module"
	depends on BR2_LINUX_KERNEL
	help
		Linux kernel module for wpanusb radio interface.
```

## sw/zephyrproject/sensortest/sgp30/Kconfig
```kconfig
# SGP30 eCO2 and TVOC sensor configuration options

# Copyright (c) 2021 Jason Kridner
# SPDX-License-Identifier: Apache-2.0

menuconfig SGP30
	bool "SGP30 sensor"
	depends on I2C
	help
	  Enable driver for SGP30 I2C-based based eCO2 and TVOC sensor.

endif # SGP30
```
